#include "skeletyl.dtsi"

&default_transform {
	col-offset = <5>;
};

&kscan0 {
	row-gpios
		= <&pro_micro_d 16 (GPIO_ACTIVE_HIGH | GPIO_PULL_DOWN)>
		, <&pro_micro_d 10 (GPIO_ACTIVE_HIGH | GPIO_PULL_DOWN)>
		, <&pro_micro_d 8  (GPIO_ACTIVE_HIGH | GPIO_PULL_DOWN)>
		, <&pro_micro_d 9  (GPIO_ACTIVE_HIGH | GPIO_PULL_DOWN)>
		;

	col-gpios
		= <&pro_micro_d 15 GPIO_ACTIVE_HIGH>
		, <&pro_micro_a  0 GPIO_ACTIVE_HIGH>
		, <&pro_micro_a  1 GPIO_ACTIVE_HIGH>
		, <&pro_micro_a  2 GPIO_ACTIVE_HIGH>
		, <&pro_micro_a  3 GPIO_ACTIVE_HIGH>
		;
};
